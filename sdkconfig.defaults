## sdkconfig.defaults
```kconfig
# 目标芯片与 Flash：ESP32-S3-WROOM-1-N16R8（16MB Flash）
CONFIG_IDF_TARGET="esp32s3"
CONFIG_ESPTOOLPY_FLASHSIZE_16MB=y
CONFIG_ESPTOOLPY_FLASHMODE_QIO=y       # 四线 Flash 模式（Kconfig 默认 DIO，正点原子例程用 QIO）
CONFIG_ESP_DEFAULT_CPU_FREQ_MHZ_240=y  # S3 满速主频（Kconfig 默认 160）

# 分区表
CONFIG_PARTITION_TABLE_CUSTOM=y
CONFIG_PARTITION_TABLE_CUSTOM_FILENAME="partitions-16MiB.csv"

# PSRAM：8MB 八线（Octal）@ 80MHz
CONFIG_SPIRAM=y
CONFIG_SPIRAM_MODE_OCT=y
CONFIG_SPIRAM_SPEED_80M=y

# FreeRTOS tick：1ms（固化，防重建 sdkconfig 时静默回落到默认 100Hz）
CONFIG_FREERTOS_HZ=1000

# 关闭 USB Serial/JTAG 次级 console（无 USB 主机消费时每次日志写阻塞 50ms）
CONFIG_ESP_CONSOLE_SECONDARY_NONE=y
```
